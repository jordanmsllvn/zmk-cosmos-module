#include "cosmos.dtsi"

&default_transform {
    col-offset = <7>;
};

&kscan0 {
    col-gpios =
        <&gpio1 6 GPIO_ACTIVE_HIGH>, /* outermost physical pin → col 0 */
        <&gpio1 4 GPIO_ACTIVE_HIGH>, /*             "        → col 1 */
        <&gpio0 11 GPIO_ACTIVE_HIGH>, /*             "        → col 2 */
        <&gpio1 0 GPIO_ACTIVE_HIGH>, /*             "        → col 3 */
        <&gpio0 24 GPIO_ACTIVE_HIGH>, /*             "        → col 4 */
        <&gpio0 22 GPIO_ACTIVE_HIGH>, /*             "        → col 5 */
        <&gpio0 20 GPIO_ACTIVE_HIGH>; /* innermost physical pin → col 6 */
};
